## CMakeLists.txt
```
# 一个最小 Zephyr 应用的 CMakeLists——注意它和"裸 CMake"的两个差别
cmake_minimum_required(VERSION 3.20)

# 差别①：project() 之前必须先 find_package(Zephyr)。
# 它做了三件事：定位 Zephyr 内核源码（ZEPHYR_BASE）、
# 读 BOARD 变量确定目标板、把 Zephyr 的整套构建逻辑（几百个模块的
# add_subdirectory + Kconfig 处理）挂进这次构建。
find_package(Zephyr REQUIRED HINTS $ENV{ZEPHYR_BASE})
project(blinky_demo C)

# 差别②：可执行文件 target 是 Zephyr 预先创建好的 app，
# 应用只往里面"挂"自己的源文件，而不是 add_executable。
target_sources(app PRIVATE src/main.c)
```

## prj.conf
```kconfig
# prj.conf = 这个应用的 Kconfig 配置（覆盖 Zephyr 默认值）
# 每行一个 CONFIG_ 选项，构建时会被合并进 .config，
# 再翻译成 autoconf.h 里的 #define——见 README 4.3 的完整链路

# 打开 GPIO 子系统：blinky 要点灯
# 效果链：CONFIG_GPIO=y → autoconf.h 有 #define CONFIG_GPIO 1
#         → drivers/gpio/ 下对应源文件被编进内核 target
CONFIG_GPIO=y

# 关掉用不到的子系统（Zephyr 默认很克制，这里演示"关"的写法）
CONFIG_CONSOLE=n
```

## src/main.c
```c
#include <zephyr/kernel.h>
#include <zephyr/drivers/gpio.h>

/* 设备树（09 模块）给出的 LED 节点：硬件描述与代码分离，
 * 这块板有没有 led0、接在哪个引脚，全由 .dts 决定，代码不写死 */
#define LED0_NODE DT_ALIAS(led0)
static const struct gpio_dt_spec led = GPIO_DT_SPEC_GET(LED0_NODE, gpios);

int main(void)
{
	if (!gpio_is_ready_dt(&led))
		return -1;
	gpio_pin_configure_dt(&led, GPIO_OUTPUT_ACTIVE);

	while (1) {
		gpio_pin_toggle_dt(&led);
		k_msleep(500);   /* Zephyr 内核 API：睡 500ms，不是 POSIX sleep */
	}
	return 0;
}
```
